## conf/machine/beyonwizu4.conf
```bitbake
#@TYPE: Machine
#@NAME: Beyonwiz U4
#@DESCRIPTION: Machine configuration for Beyonwiz U4

IMAGEDIR = "beyonwiz/u4"

MACHINE_ESSENTIAL_EXTRA_RDEPENDS += "\
    et-dvb-modules-${MACHINE} \
    et-initrd-et13000 \
    "

MACHINE_FEATURES += "dvbc-only"

require conf/machine/include/etxx00-oem.inc

MTD_BLACK  = "mmcblk0"

PREFERRED_VERSION_linux-etxx00 = "4.9.51"
```

## conf/machine/et13000.conf
```bitbake
#@TYPE: Machine
#@NAME: Xtrend et13000
#@DESCRIPTION: Machine configuration for Xtrend et13000

MACHINE_ESSENTIAL_EXTRA_RDEPENDS += "\
    et-dvb-modules-beyonwizu4 \
    et-initrd-${MACHINE} \
    "

require conf/machine/include/etxx00-oem.inc

PREFERRED_VERSION_linux-etxx00 = "4.9.51"

MACHINE_FEATURES += "textlcd multitranscoding fanctrl SCART RCA HDMI-IN-FHD"

SOC_FAMILY = "bcm7252s"
```

## conf/machine/et1x000.conf
```bitbake
#@TYPE: Machine
#@NAME: Xtrend et1x000
#@DESCRIPTION: Machine configuration for Xtrend et1x000

KERNELVERSION = "4.1.37"

PREFERRED_PROVIDER_virtual/egl ?= "et-v3ddriver-${MACHINE}"
PREFERRED_PROVIDER_virtual/libgles2 ?= "et-v3ddriver-${MACHINE}"

MACHINE_ESSENTIAL_EXTRA_RDEPENDS += "\
	et-dvb-modules-${MACHINE} \
	et-initrd-${MACHINE} \
	et-v3ddriver-${MACHINE} \
	platform-util-${MACHINE} \
	"

require conf/machine/include/etxx00-oem.inc

PREFERRED_VERSION_linux-etxx00 = "${KERNELVERSION}"

MACHINE_FEATURES += "ci 7segment kodi19"

SOC_FAMILY = "bcm7251s"

RCTYPE = "504"
RCNAME = "et7x00mini"
```

## conf/machine/et4x00.conf
```bitbake
#@TYPE: Machine
#@NAME: Xtrend et4x00
#@DESCRIPTION: Machine configuration for the Xtrend et4x00

DEFAULTTUNE = "mips32el-nf"

CHIPSET = "bcm7358"

require conf/machine/include/etxx00-2g.inc

# Broken bootloader can only flash around 100 MB
FLASHSIZE = "96"

RCTYPE = "13"

MACHINE_FEATURES += "nofhdskin blindscan-dvbs RCA"
```

## conf/machine/et5x00.conf
```bitbake
#@TYPE: Machine
#@NAME: Xtrend et5x00
#@DESCRIPTION: Machine configuration for the Xtrend et5x00

MACHINE_FEATURES += "blindscan-dvbs nofhdskin"

CHIPSET = "bcm7413"

require conf/machine/include/etxx00.inc

RCTYPE = "7"
```

## conf/machine/et6x00.conf
```bitbake
#@TYPE: Machine
#@NAME: Xtrend et6x00
#@DESCRIPTION: Machine configuration for the Xtrend et6x00

MACHINE_FEATURES += "blindscan-dvbs"

CHIPSET = "bcm7413"

require conf/machine/include/etxx00.inc
```

## conf/machine/et7x00.conf
```bitbake
#@TYPE: Machine
#@NAME: Xtrend et7x00
#@DESCRIPTION: Machine configuration for the Xtrend et7x00

CHIPSET = "bcm7362"

require conf/machine/include/et7k.inc

MACHINE_FEATURES += "textlcd blindscan-dvbs SCART YUV vfdsymbol"
```

## conf/machine/et8000.conf
```bitbake
#@TYPE: Machine
#@NAME: Xtrend et8000
#@DESCRIPTION: Machine configuration for the Xtrend et8000

MACHINE_FEATURES += "textlcd dvb-c blindscan-dvbc"

CHIPSET = "bcm7241"

require conf/machine/include/etxx00-2g.inc

MACHINE_FEATURES += "middleflash"

# Broken bootloader can only flash around 100 MB
FLASHSIZE = "96"

RCTYPE = "9"
```

## conf/machine/et8500.conf
```bitbake
#@TYPE: Machine
#@NAME: Xtrend et8500
#@DESCRIPTION: Machine configuration for the Xtrend et8500

CHIPSET = "bcm7241"

require conf/machine/include/et7k.inc

MACHINE_FEATURES += "colorlcd720 dvb-c ci fanctrl videoenhancement blindscan-dvbc RCA"
```

## conf/machine/et9x00.conf
```bitbake
#@TYPE: Machine
#@NAME: Xtrend et9x00
#@DESCRIPTION: Machine configuration for the Xtrend et9x00

CHIPSET = "bcm7413"

require conf/machine/include/etxx00.inc

RCTYPE = "9"

MACHINE_FEATURES += "ci fanctrl textlcd SCART"
```

## conf/machine/include/et.inc
```bitbake
# We know about rtc
MACHINE_FEATURES_BACKFILL_CONSIDERED += "rtc"


MACHINE_ESSENTIAL_EXTRA_RDEPENDS = "\
	et-dvb-modules-${MACHINE} \
	"

MACHINE_ESSENTIAL_EXTRA_RRECOMMENDS = "\
	kernel-module-cdfs \
	"

KERNEL_MODULE_AUTOLOAD += "xfs"

MACHINE_EXTRA_RRECOMMENDS = " \
	${@bb.utils.contains("GST_VERSION", "1.0", "gstreamer1.0-plugin-dvbmediasink", "gst-plugin-dvbmediasink", d)} \
	ntfs-3g \
	"

MTD_KERNEL = "mtd1"
MTD_ROOTFS = "mtd2"
KERNEL_FILE = "kernel.bin"
ROOTFS_FILE = "rootfs.bin"

DVBMEDIASINK_CONFIG = "--with-wma --with-wmv --with-pcm --with-dts --with-eac3"

TARGET_ARCH = "mipsel"
DEFAULTTUNE ?= "mips32el"

KERNEL_IMAGETYPE = "vmlinux"
KERNEL_OUTPUT = "${KERNEL_IMAGETYPE}"
KERNEL_OUTPUT_DIR = "."
KERNEL_CONSOLE = "null"

IMAGE_FSTYPES ?= "ubi"

UBI_VOLNAME = "rootfs"

IMAGEDIR ?= "${MACHINE}"
IMGDEPLOYDIR ?= "${DEPLOY_DIR_IMAGE}"

IMAGE_CMD_ubi_append = " \
	mkdir -p ${IMGDEPLOYDIR}/${IMAGEDIR}; \
	cp -f ${IMGDEPLOYDIR}/${IMAGE_NAME}${IMAGE_NAME_SUFFIX}.ubi ${IMGDEPLOYDIR}/${IMAGEDIR}/rootfs.bin; \
	gzip -9c ${DEPLOY_DIR_IMAGE}/vmlinux-${MACHINE}.bin > ${IMGDEPLOYDIR}/${IMAGEDIR}/kernel.bin; \
	echo "${IMAGE_NAME}" > ${IMGDEPLOYDIR}/${IMAGEDIR}/imageversion; \
	echo "rename this file to 'force' to force an update without confirmation" > ${IMGDEPLOYDIR}/${IMAGEDIR}/noforce; \
	rm -f ${IMGDEPLOYDIR}/*.zip; \
	cd ${IMGDEPLOYDIR}; \
	zip ${IMAGE_NAME}_usb.zip ${IMAGEDIR}/*; \
	rm -rf ${IMAGEDIR}; \
	"

MACHINE_FEATURES += "alsa usbhost wlan kernelwifi 3dtv switchoff osdposition hdmicec"

require conf/machine/include/tune-mips32.inc

BOX_BRAND = "xtrend"

PREFERRED_PROVIDER_virtual/kernel = "linux-etxx00"
```

## conf/machine/include/etxx00.inc
```bitbake
require conf/machine/include/et.inc

PREFERRED_PROVIDER_virtual/blindscan-dvbs = "et-blindscan-dvbs-utils"

MKUBIFS_ARGS = "-m 2048 -e 126976 -c 4096"
UBINIZE_ARGS = "-m 2048 -p 128KiB"

IMAGE_CMD_ubi_prepend = " \
	rm -Rf ${IMAGE_ROOTFS}/tmp/*; \
	"

# Broken bootloader can only flash around 100 MB
FLASHSIZE = "96"

PREFERRED_VERSION_linux-etxx00 = "3.8.7"

MACHINE_FEATURES += "blindscan-tbs blindscan-dvbs YUV"
```
